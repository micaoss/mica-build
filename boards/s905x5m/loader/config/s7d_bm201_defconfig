## boards/s905x5m/loader/config/s7d_bm201_defconfig
```kconfig
CONFIG_ARM=y
CONFIG_ARCH_MESON=y
CONFIG_DM_GPIO=y
CONFIG_DEFAULT_DEVICE_TREE="meson-s7d-bm201"
CONFIG_SYS_PROMPT="s7d_bm201# "
CONFIG_MESON_S7D=y
CONFIG_AMLOGIC_MODIFY=y
CONFIG_SECURE_POWER_CONTROL=y
CONFIG_AML_TSENSOR=y
CONFIG_AML_TSENSOR_COOL=y
CONFIG_KEY_PRESERVE=y
CONFIG_AMLOGIC_ETH=y
CONFIG_AMLOGIC_EMMC=y
CONFIG_BL2E_96K=y
CONFIG_S7D_BM201=y
# CONFIG_ENABLE_AML_GPIO_UPGRADE is not set
CONFIG_DEBUG_UART_BASE=0xfe07a000
CONFIG_DEBUG_UART_CLOCK=24000000
CONFIG_ARMV8_CRYPTO=y
CONFIG_DEBUG_UART=y
CONFIG_OF_BOARD_SETUP=y
CONFIG_BOOTCOMMAND="micaboot"
# CONFIG_USE_PREBOOT is not set
# CONFIG_SILENT_CONSOLE is not set
# CONFIG_DISPLAY_CPUINFO is not set
# CONFIG_DISPLAY_BOARDINFO is not set
CONFIG_BOARD_LATE_INIT=y
# CONFIG_CMD_BDI is not set
CONFIG_CMD_ADTIMG=y
# CONFIG_CMD_IMI is not set
CONFIG_CMD_CLK=y
CONFIG_CMD_GPIO=y
CONFIG_CMD_I2C=y
# CONFIG_CMD_LOADB is not set
# CONFIG_CMD_LOADS is not set
CONFIG_CMD_MMC=y
CONFIG_CMD_MTD=y
CONFIG_CMD_USB=y
CONFIG_CMD_CONSOLE=y
# CONFIG_CMD_BOOTMENU is not set
# CONFIG_CMD_BOOTEFI_BOOTMGR is not set
CONFIG_CMD_WDT=y
CONFIG_CMD_SETEXPR=y
# CONFIG_CMD_SOURCE is not set
# CONFIG_CMD_IMPORTENV is not set
CONFIG_CMD_FAT=y
# CONFIG_CMD_BOOTI is not set
CONFIG_CMD_FDT=y
# CONFIG_LEGACY_IMAGE_FORMAT is not set
CONFIG_HUSH_PARSER=y
CONFIG_CMD_CACHE=y
CONFIG_CMD_MTDPARTS=y
CONFIG_AML_STORAGE=y
CONFIG_CMD_BOOTCTOL_AVB=y
CONFIG_CMD_BMP=y
CONFIG_CMD_SLEEP=y
CONFIG_CMD_CLKMSR=y
CONFIG_CMD_SARADC=y
CONFIG_CMD_JTAG=y
CONFIG_CMD_IR=y
CONFIG_CMD_INI=y
CONFIG_AML_PARTITION=y
CONFIG_OF_CONTROL=y
CONFIG_OF_EMBED=y
CONFIG_ENV_SOURCE_FILE="../env/android_ott"
# CONFIG_ENV_IS_IN_MMC is not set
# CONFIG_SYS_REDUNDAND_ENVIRONMENT is not set
CONFIG_ENV_SIZE=0x10000
# CONFIG_BOOTCOUNT_LIMIT is not set
# CONFIG_BOOTCOUNT_ENV is not set
CONFIG_EFUSE=y
CONFIG_ADC=y
CONFIG_CLK=y
CONFIG_USB_FUNCTION_FASTBOOT=y
CONFIG_FASTBOOT_FLASH=y
CONFIG_FASTBOOT_FLASH_MMC_DEV=1
CONFIG_DM_I2C=y
CONFIG_SYS_I2C_MESON=y
CONFIG_MISC=y
CONFIG_MMC_HS200_SUPPORT=y
CONFIG_MMC_MESON_GX=y
CONFIG_MTD=y
CONFIG_PHYLIB=y
CONFIG_PHY=y
CONFIG_PINCTRL=y
CONFIG_DM_REGULATOR=y
CONFIG_DM_PWM=y
CONFIG_PWM_MESON=y
CONFIG_DEBUG_UART_ANNOUNCE=y
CONFIG_DEBUG_UART_SKIP_INIT=y
CONFIG_MESON_SERIAL=y
CONFIG_TEE=y
CONFIG_OPTEE=y
CONFIG_USB=y
CONFIG_USB_XHCI_HCD=y
# CONFIG_USB_STORAGE is not set
CONFIG_USB_KEYBOARD=y
CONFIG_SYS_USB_EVENT_POLL=y
# CONFIG_SYS_USB_EVENT_POLL_VIA_CONTROL_EP is not set
CONFIG_USB_GADGET=y
# CONFIG_AML_FACTORY_BURN_LOCAL_UPGRADE is not set
CONFIG_AML_V3_FACTORY_BURN=y
CONFIG_AML_V3_USB_TOOl=y
# CONFIG_WATCHDOG_AUTOSTART is not set
CONFIG_WDT=y
CONFIG_AML_DRIVER=y
CONFIG_AML_MEDIA=y
CONFIG_AML_VOUT=y
CONFIG_AML_OSD=y
CONFIG_AML_DOLBY=y
CONFIG_AML_VPP=y
CONFIG_AML_VPU=y
CONFIG_AML_CVBS=y
CONFIG_AML_HDMITX=y
CONFIG_AML_HDMITX21=y
CONFIG_VIDEO=y
# CONFIG_VIDEO_LOGO is not set
# CONFIG_BACKLIGHT is not set
# CONFIG_VIDEO_BPP8 is not set
CONFIG_VIDEO_BPP16=y
# CONFIG_VIDEO_BPP32 is not set
CONFIG_VIDEO_ANSI=y
CONFIG_CONSOLE_NORMAL=y
CONFIG_SYS_WHITE_ON_BLACK=y
# CONFIG_VIDEO_SIMPLE is not set
# CONFIG_VIDEO_MESON is not set
CONFIG_CONSOLE_MUX=y
CONFIG_SYS_CONSOLE_IS_IN_ENV=y
CONFIG_UNIFY_KEY_MANAGE=y
CONFIG_SECURE_STORAGE=y
CONFIG_MESON_LEDS_STATE_CONTROL=y
CONFIG_PHY_AMLOGIC=y
CONFIG_PINCTRL_MESON_S7D=y
CONFIG_AMLOGIC_USB=y
CONFIG_USB_XHCI_CRG=y
CONFIG_AMLOGIC_USB2_PHY=y
CONFIG_AMLOGIC_USB3_PHY=y
CONFIG_USB_GADGET_CRG=y
CONFIG_WDT_MESON=y
CONFIG_AMLOGIC_SARADC=y
CONFIG_AMLOGIC_AMFC=y
CONFIG_XBC=y
CONFIG_SHA1=y
CONFIG_ZSTD=y
CONFIG_OF_LIBFDT_OVERLAY=y
CONFIG_LMB_MAX_REGIONS=9
CONFIG_CMD_SCMI_SHMEM_ADDR=y
# CONFIG_CMD_CFGLOAD is not set
CONFIG_FS_CRAMFS=y
CONFIG_CMD_CRAMFS=y
CONFIG_FAT_WRITE=y
CONFIG_MICA_FILE_BOOT=y
CONFIG_ENV_IS_NOWHERE=y
# CONFIG_ENV_IS_IN_STORAGE is not set
CONFIG_FIT=y
CONFIG_FIT_SIGNATURE=y
CONFIG_RSA=y
CONFIG_RSA_VERIFY=y
CONFIG_SHA256=y
CONFIG_CMD_BOOTM=y
CONFIG_CMD_EXT4=y
CONFIG_FS_EXT4=y
CONFIG_EFI_PARTITION=y
CONFIG_WATCHDOG=y
CONFIG_SYS_BOOTM_LEN=0x8000000
CONFIG_TOOLS_FIT_SIGNATURE=y
# CONFIG_CMD_SAVEENV is not set
# CONFIG_AUTOBOOT_KEYED is not set
CONFIG_BOOTDELAY=1
CONFIG_USE_BOOTCOMMAND=y
CONFIG_FIT_FULL_CHECK=y
CONFIG_IMAGE_SIGN_INFO=y
# CONFIG_DISTRO_DEFAULTS is not set
```

## tests/signed-boot-lab/boot.its
```
/dts-v1/;
/ {
    description = "mica cx3576 signed boot prototype";
    #address-cells = <1>;
    images {
        kernel {
            description = "Linux kernel";
            data = /incbin/("kernel.bin");
            type = "kernel"; arch = "arm64"; os = "linux"; compression = "none";
            load = <0x00280000>; entry = <0x00280000>;
            hash-1 { algo = "sha256"; };
        };
        fdt {
            description = "rk3576-cx3576z device tree";
            data = /incbin/("board.dtb");
            type = "flat_dt"; arch = "arm64"; compression = "none";
            load = <0x01a00000>;
            hash-1 { algo = "sha256"; };
        };
        ramdisk {
            description = "initramfs";
            data = /incbin/("initrd.img");
            type = "ramdisk"; arch = "arm64"; os = "linux"; compression = "none";
            load = <0x01b00000>;
            hash-1 { algo = "sha256"; };
        };
    };
    configurations {
        default = "conf-1";
        conf-1 {
            description = "mica deployment";
            kernel = "kernel"; fdt = "fdt"; ramdisk = "ramdisk";
            signature-1 {
                algo = "sha256,rsa2048";
                key-name-hint = "micadev";
                sign-images = "kernel", "fdt", "ramdisk";
            };
        };
    };
};
```
